# pse84 register map
Vendor: Cypress Semiconductor; Series: PSE84; File version: 1.0
CPU: CM33 r0p1, little endian, MPU, FPU, VTOR, 3 interrupt priority bits
Registers are 32-bit, read-write, reset 0x0 unless marked. A register's access mark holds for its fields unless they carry their own. Offsets are from the block's base; [hi:lo] are bit positions; lines under a group give offsets from that group; {n}, {i} and the like mark numbered series.

## PPC0 — Peripheral Protection Controller
Base 0x42020000
Same registers: PPC1 0x44020000
0x00 PPC group — Peripheral Protection Controller
  0x00 CTL — PPC Control Registers
    [0] RESP_CFG — Response Configuration. This field configures the security violation response. 0 - Read-Zero Write Ignore (RZWI) 1 - Bus Error
  0x0C LOCK_MASK — Locked Mask
    [31:0] LOCK_MASK — A mask that indicates which protection contexts are 'locked'. Once locked, a protection context cannot be unlocked until the next reset or power cycle. Bit i specifies the locked status for protection context i. 0: The protection context is unlocked. 1: The protection context is locked. When a PC is locked, the PPC_PC_MASK, PPC_NS_ATT and PPC_S_P_ATT register bits for peripheral regions to which this PC has access can no longer be modified (PPC_NS_P_ATT is not subject to these restrictions). The one exception to this is that PPC_PC_MASK bits associated with other protection contexts that are not themselves locked can still be cleared (but not set).
  {0x1000+4j} PC_MASK[{j}] (j=0..1023) reset 0xFFFFFFFF — Protection Context Mask
    [31:0] PC_MASK — A mask that indicates which protection contexts have access to a peripheral region. Bit i specifies the access for protection context i. 0: The protection context has no access to this region. 1: The protection context has access to this region, subject to secure and privilege attribute constraints setup in PPC_NS_ATT, PPC_S_P_ATT, PPC_NS_P_ATT registers)
  {0x2000+4j} NS_ATT[{j}] (j=0..31) — Non-secure attribute
    [31:0] NS — Non-Secure. Each bit indicates whether access to a peripheral region must be secure or non-secure: IF SECURITY_AWARE=0 0 - allow only secure access to respective peripheral region. 1 - allow only non-secure access to respective peripheral region. IF SECURITY_AWARE=1 0 - allow only secure access to respective peripheral region. 1 - allows both secure and non-secure access to respective peripheral region. (Note that, depending on this setting the privilege access requirement for this region is specified in the corresponding PPC_S_P_ATT or PPC_NS_P_ATT register)
  {0x2400+4j} S_P_ATT[{j}] (j=0..31) — Secure Privilege Attribute
    [31:0] S_P — Secure Privilege. Each bit indicates whether access to a secure peripheral region requires privilege: 0 - allow only secure privileged access to respective peripheral region. 1 - allow only secure unprivileged or privileged access to respective peripheral region.
  {0x4000+4j} NS_P_ATT[{j}] (j=0..31) — Non-secure Privilege Attribute
    [31:0] NS_P — Non-Secure Privilege. Each bit indicates whether access to a non-secure peripheral region requires privilege: 0 - allow only non-secure privileged access to respective peripheral region. 1 - allow only non-secure unprivileged or privileged access to respective peripheral region.
  {0x5000+4j} R_ADDR[{j}] (j=0..310) group — Region Address
    0x00 R_ADDR ro — Region Address
      [31:2] R_ADDR — This field specifies the base address of the peripheral region. The region size is defined by R_ATTR.R_SIZE. A region of n Bytes mus be n Byte aligned. Therefore, some of the lesser significant address bits of ADDR must be '0's. E.g., a 64KB address region (R_SIZE is '15') must be 64 KByte aligned, and R_ADDR[13:0] must be '0's.
  {0x6000+4j} R_ATT[{j}] (j=0..310) group — Region Attribute
    0x00 R_ATT ro — Region Attribute
      [28:24] R_SIZE — This field specifies the size of the peripheral region: '0': Undefined. '1': 4 B region (this is the smallest region size). '2': 8 B region '3': 16 B region '4': 32 B region '5': 64 B region '6': 128 B region '7': 256 B region '8': 512 B region '9': 1 KB region '10': 2 KB region '11': 4 KB region '12': 8 KB region '13': 16 KB region '14': 32 KB region '15': 64 KB region '16': 128 KB region '17': 256 KB region '18': 512 KB region '19': 1 MB region '20': 2 MB region '21': 4 MB region '22': 8 MB region '23': 16 MB region '24': 32 MB region '25': 64 MB region '26': 128 MB region '27': 256 MB region '28': 512 MB region '29': 1 GB region '30': 2 GB region '31': 4 GB region
