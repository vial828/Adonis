# pse84 register map
Vendor: Cypress Semiconductor; Series: PSE84; File version: 1.0
CPU: CM33 r0p1, little endian, MPU, FPU, VTOR, 3 interrupt priority bits
Registers are 32-bit, read-write, reset 0x0 unless marked. A register's access mark holds for its fields unless they carry their own. Offsets are from the block's base; lines under a group give offsets from that group; [hi:lo] are bit positions; {n}, {i} and the like mark numbered series; 'fields as' and 'values as' point back to an identical list; <NAME> marks a mode.

## Memory map
0x42000000 PERI0 size 0x10000 — Peripheral interconnect
0x42020000 PPC0 size 0x10000 — Peripheral Protection Controller
0x42040000 PERI_PCLK0 size 0x20000 — Peripheral PCLK groups
0x42200000 RRAMC0 size 0x20000 — RRAM controller registers
0x42220000 RAMC_PPU0 size 0x1000 — Power Policy Unit Registers for System RAM
0x42221000 RAMC_PPU1 size 0x1000
0x42223000 ICACHE0 size 0x1000 — CM33_0/1 CA APB interface
0x42225000 CPUSS_PPU size 0x1000 — Power Policy Unit Registers for CPUSS
0x42230000 RAMC0 size 0x10000 — RAMC0/1/2
0x42240000 RAMC1 size 0x10000
0x42260000 MXCM33 size 0x10000 — MXCM33-0/1
0x42270000 DW0 size 0x10000 — DW-0/1
0x42280000 DW1 size 0x10000
0x42290000 CPUSS size 0x4000 — SYSCPUSS registers
0x42294000 MS_CTL_2_0 size 0x4000 — Master control registers
0x42294050 MS5 size 0x10 — Master protection context control
0x42295050 MS_PC5 size 0x10 — Master protection context value
0x42298000 CPUSS_SL_CTL size 0x10 — SYSCPUSS Internal slave control registers
0x422A0000 IPC0 size 0x10000 — IPC
0x422B0000 FAULT size 0x10000 — Fault structures
0x42400000 SRSS size 0x10000 — SRSS Core Registers
0x42410000 PWRMODE size 0x10000 — SRSS Power Mode Control Registers
0x42420000 RTC size 0x10000 — SRSS RTC Registers
0x42430000 DEBUG600 size 0x100
0x42430100 M0SECCPUSS_STATUS size 0x100 — M0 Secured CPU subsystem
0x42800000 HSIOM size 0x4000 — IO Matrix (IOM)
0x42810000 GPIO size 0x10000 — IO port control/configuration
0x42820000 SMARTIO size 0x10000 — Programmable IO configuration
0x42840000 CANFD0 size 0x20000 — CAN Controller
0x42860000 TCPWM0 size 0x20000 — Timer/Counter/PWM
0x42880000 LPCOMP size 0x10000 — Low Power Comparators
0x42990000 SCB0 size 0x10000 — Serial Communications Block (SPI/UART/I2C)
{0x42980000+0x10000*n} SCB{n} size 0x10000 (n=2..11)
0x42A50000 I3C size 0x10000 — I3C controller top
0x42C10000 ETH0 size 0x10000 — Ethernet Interface
0x42D00000 SCB1 size 0x10000
0x42D80000 MXNNLITE_1_0 size 0x1000
0x42E00000 CTBL0 size 0x10000 — Continuous Time Block Lite
0x42E10000 CTBL1 size 0x10000
0x42E40000 PTC size 0x10000 — Programmable Threshold Comparator
0x42E60000 DAC0 size 0x10000 — DAC
0x42E70000 DAC1 size 0x10000
0x42E80000 SAR size 0x10000
0x42ED0000 ACTRLR size 0x10000 — Autonomnous Controller
0x42EE0000 INFRA size 0x10000 — LPPASS infrastructure
0x42EF0000 LPPASS_MMIO size 0x10000 — LPPASS top-level MMIO
0x44000000 PERI1 size 0x10000
0x44020000 PPC1 size 0x10000
0x44040000 PERI_PCLK1 size 0x20000
0x44100000 PPU_APPCPUSS size 0x1000 — Power Policy Unit Registers for APPCPUSS PPU
0x44101000 PPU_CM55_0 size 0x1000 — Power Policy Unit Registers for CM55_0 PPU
0x44103000 PD size 0x20 — Power Domain Controller
0x44160000 MXCM55 size 0x10000 — MXCM55-0/1
0x441A0000 SAXI_DMAC size 0x10000 — AXI DMAC
0x441C0000 APPCPUSS size 0x4000 — APPCPUSS registers
0x441C4000 MS_CTL size 0x4000 — Master control registers
0x441C8000 APPCPUSS_SL_CTL size 0x10 — APPCPUSS Internal slave control registers
0x441D0000 IPC1 size 0x10000
0x44400000 SMIF0 size 0x80000 — SMIF subsystem (bridge + 2 core SMIFs, OR no bridge and 1 core SMIF)
0x44480000 TDM0 size 0x10000 — TDM
0x44490000 PDM0 size 0x10000 — PDM
0x44600000 U550 size 0x10000 — Top level section for IP generation only, contains IP memory map
0x44640000 SOCMEM size 0x40000 — SoC memory
0x44800000 GFXSS size 0x4000
0x44810000 SDHC0 size 0x10000 — SD/eMMC Host Controller
0x44820000 SDHC1 size 0x10000
0x44900000 USBHS size 0x80000 — Regmap for both Subsystem and Controller IP
0xE0000000 SYSAP size 0x20000000 — System debug Access Port (SYSAP) registers

## Interrupts
0 ioss_interrupts_gpio_0 (CPUSS) — GPIO Port Interrupt #0
1 ioss_interrupts_gpio_2 (CPUSS) — GPIO Port Interrupt #2
1 m33syscpuss_interrupts_ipc_dpslp_0 (CPUSS) — m33syscpuss Inter Process Communication Interrupt #0
2 ioss_interrupts_gpio_3 (CPUSS) — GPIO Port Interrupt #3
2 m33syscpuss_interrupts_ipc_dpslp_1 (CPUSS) — m33syscpuss Inter Process Communication Interrupt #1
{n-2} ioss_interrupts_gpio_{n} (CPUSS) (n=5..21) — GPIO Port Interrupt #{n}
3 m33syscpuss_interrupts_ipc_dpslp_2 (CPUSS) — m33syscpuss Inter Process Communication Interrupt #2
4 m33syscpuss_interrupts_ipc_dpslp_3 (CPUSS) — m33syscpuss Inter Process Communication Interrupt #3
5 m33syscpuss_interrupts_ipc_dpslp_4 (CPUSS) — m33syscpuss Inter Process Communication Interrupt #4
6 m33syscpuss_interrupts_ipc_dpslp_5 (CPUSS) — m33syscpuss Inter Process Communication Interrupt #5
7 m33syscpuss_interrupts_ipc_dpslp_6 (CPUSS) — m33syscpuss Inter Process Communication Interrupt #6
8 m33syscpuss_interrupts_ipc_dpslp_7 (CPUSS) — m33syscpuss Inter Process Communication Interrupt #7
20 ioss_interrupt_vdd (CPUSS) — GPIO Supply Detect Interrupt
20 ioss_interrupts_sec_gpio_0 (CPUSS) — GPIO Port Secure Interrupt #0
21 ioss_interrupt_gpio (CPUSS) — GPIO All Ports
21 ioss_interrupts_sec_gpio_2 (CPUSS) — GPIO Port Secure Interrupt #2
22 ioss_interrupts_sec_gpio_3 (CPUSS) — GPIO Port Secure Interrupt #3
22 scb_0_interrupt (CPUSS) — Serial Communication Block #0 (DeepSleep capable)
{n+18} ioss_interrupts_sec_gpio_{n} (CPUSS) (n=5..21) — GPIO Port Secure Interrupt #{n}
23 srss_interrupt (CPUSS) — Other combined Interrupts for srss (LVD, CLKCAL)
24 lpcomp_interrupt (CPUSS) — LPCOMP
25 m33syscpuss_interrupts_ipc_dpslp_0 (CPUSS) — m33syscpuss Inter Process Communication Interrupt #0
26 m33syscpuss_interrupts_ipc_dpslp_1 (CPUSS) — m33syscpuss Inter Process Communication Interrupt #1
27 m33syscpuss_interrupts_ipc_dpslp_2 (CPUSS) — m33syscpuss Inter Process Communication Interrupt #2
28 m33syscpuss_interrupts_ipc_dpslp_3 (CPUSS) — m33syscpuss Inter Process Communication Interrupt #3
29 m33syscpuss_interrupts_ipc_dpslp_4 (CPUSS) — m33syscpuss Inter Process Communication Interrupt #4
30 m33syscpuss_interrupts_ipc_dpslp_5 (CPUSS) — m33syscpuss Inter Process Communication Interrupt #5
31 m33syscpuss_interrupts_ipc_dpslp_6 (CPUSS) — m33syscpuss Inter Process Communication Interrupt #6
32 m33syscpuss_interrupts_ipc_dpslp_7 (CPUSS) — m33syscpuss Inter Process Communication Interrupt #7
33 srss_interrupt_wdt (CPUSS) — Interrupt for WDT
34 srss_interrupt_mcwdt_1 (CPUSS) — Interrupt for MCWDT[]
35 srss_interrupt_rtc (CPUSS) — Interrupt from RTC
36 pass_interrupt_lppass (CPUSS) — LPPASS interrupt
37 pass_interrupt_fifo (CPUSS) — LPPASS FIFO interrupt
38 mxu55_interrupt_npu (CPUSS) — Interrupt requests of armu55 (NPU)
39 ioss_interrupts_gpio_1 (CPUSS) — GPIO Port Interrupt #1
40 ioss_interrupt_vdd (CPUSS) — GPIO Supply Detect Interrupt
40 ioss_interrupts_gpio_4 (CPUSS) — GPIO Port Interrupt #4
41 ioss_interrupt_gpio (CPUSS) — GPIO All Ports
41 srss_interrupt_main_ppu (CPUSS) — Interrupt from Main PPU
42 ioss_interrupt_sec_gpio (CPUSS) — GPIO All Ports - Secured version
42 srss_interrupt_srss_pd1_ppu (CPUSS) — Interrupt from PD1 PPU
43 m55appcpuss_interrupt_ppu_appcpuss (CPUSS) — PPU APPCPUSS
43 scb_0_interrupt (CPUSS) — Serial Communication Block #0 (DeepSleep capable)
44 m55appcpuss_interrupt_ppu_cm55_0 (CPUSS) — PPU CM55
44 srss_interrupt (CPUSS) — Other combined Interrupts for srss (LVD, CLKCAL)
45 lpcomp_interrupt (CPUSS) — LPCOMP
45 mxu55_interrupt_ppu (CPUSS) — Interrupt requests of mxu55.PPU
46 m55appcpuss_interrupts_ipc_dpslp_0 (CPUSS) — m55appcpuss Inter Process Communication Interrupt #0
46 socmem_interrupt_ppu (CPUSS) — Interrupt requests of socmem.PPU
47 m55appcpuss_interrupts_ipc_dpslp_0 (CPUSS) — m55appcpuss Inter Process Communication Interrupt #0
47 m55appcpuss_interrupts_ipc_dpslp_1 (CPUSS) — m55appcpuss Inter Process Communication Interrupt #1
48 m55appcpuss_interrupts_ipc_dpslp_1 (CPUSS) — m55appcpuss Inter Process Communication Interrupt #1
48 m55appcpuss_interrupts_ipc_dpslp_2 (CPUSS) — m55appcpuss Inter Process Communication Interrupt #2
49 m55appcpuss_interrupts_ipc_dpslp_2 (CPUSS) — m55appcpuss Inter Process Communication Interrupt #2
49 m55appcpuss_interrupts_ipc_dpslp_3 (CPUSS) — m55appcpuss Inter Process Communication Interrupt #3
50 m55appcpuss_interrupts_ipc_dpslp_3 (CPUSS) — m55appcpuss Inter Process Communication Interrupt #3
50 m55appcpuss_interrupts_ipc_dpslp_4 (CPUSS) — m55appcpuss Inter Process Communication Interrupt #4
51 m55appcpuss_interrupts_ipc_dpslp_4 (CPUSS) — m55appcpuss Inter Process Communication Interrupt #4
51 m55appcpuss_interrupts_ipc_dpslp_5 (CPUSS) — m55appcpuss Inter Process Communication Interrupt #5
52 m55appcpuss_interrupts_ipc_dpslp_5 (CPUSS) — m55appcpuss Inter Process Communication Interrupt #5
52 m55appcpuss_interrupts_ipc_dpslp_6 (CPUSS) — m55appcpuss Inter Process Communication Interrupt #6
53 m55appcpuss_interrupts_ipc_dpslp_6 (CPUSS) — m55appcpuss Inter Process Communication Interrupt #6
53 m55appcpuss_interrupts_ipc_dpslp_7 (CPUSS) — m55appcpuss Inter Process Communication Interrupt #7
54 m55appcpuss_interrupts_ipc_dpslp_7 (CPUSS) — m55appcpuss Inter Process Communication Interrupt #7
54 srss_interrupt_wdt (CPUSS) — Interrupt for WDT
55 mxnnlite_interrupt_mxnnlite (CPUSS) — Interrupt of MXNNLITE
55 srss_interrupt_mcwdt_0 (CPUSS) — Interrupt for MCWDT[]
56 m55appcpuss_interrupt_cm55_0_fp (CPUSS) — CM33 0 Floating Point Interrupt
56 srss_interrupt_rtc (CPUSS) — Interrupt for RTC
57 m55appcpuss_interrupts_cm55_0_cti_0 (CPUSS)
57 pass_interrupt_lppass (CPUSS) — LPPASS interrupt
58 m55appcpuss_interrupts_cm55_0_cti_1 (CPUSS)
58 pass_interrupt_fifo (CPUSS) — LPPASS FIFO interrupt
59 ioss_interrupts_gpio_1 (CPUSS) — GPIO Port Interrupt #1 (SMIF0)
59 m55appcpuss_interrupt_msc (CPUSS)
60 ioss_interrupts_gpio_4 (CPUSS) — GPIO Port Interrupt #4 (SMIF1)
60 m33syscpuss_interrupts_dw0_0 (CPUSS) — cpuss[0] DataWire #0, Channel #0
61 m33syscpuss_interrupts_dw0_1 (CPUSS) — cpuss[0] DataWire #0, Channel #1
62 m33syscpuss_interrupts_dw0_2 (CPUSS) — cpuss[0] DataWire #0, Channel #2
63 m33syscpuss_interrupts_dw0_3 (CPUSS) — cpuss[0] DataWire #0, Channel #3
63 srss_interrupt_main_ppu (CPUSS) — Interrupt from Main PPU
64 m33syscpuss_interrupts_dw0_4 (CPUSS) — cpuss[0] DataWire #0, Channel #4
64 srss_interrupt_srss_pd1_ppu (CPUSS) — Interrupt from PD1 PPU
65 m33syscpuss_interrupt_ppu_sramc0 (CPUSS) — PPU SRAM0
65 m33syscpuss_interrupts_dw0_5 (CPUSS) — cpuss[0] DataWire #0, Channel #5
66 m33syscpuss_interrupt_ppu_sramc1 (CPUSS) — PPU SRAM1
66 m33syscpuss_interrupts_dw0_6 (CPUSS) — cpuss[0] DataWire #0, Channel #6
67 m33syscpuss_interrupt_ppu_cpuss (CPUSS) — cpuss[0] PPU Interrupt
67 m33syscpuss_interrupts_dw0_7 (CPUSS) — cpuss[0] DataWire #0, Channel #7
68 m33syscpuss_interrupts_dw0_8 (CPUSS) — cpuss[0] DataWire #0, Channel #8
68 mxu55_interrupt_ppu (CPUSS) — Interrupt requests of mxu55.PPU
69 m33syscpuss_interrupts_dw0_9 (CPUSS) — cpuss[0] DataWire #0, Channel #9
69 socmem_interrupt_ppu (CPUSS) — Interrupt requests of socmem.PPU
70 m33syscpuss_interrupts_dw0_10 (CPUSS) — cpuss[0] DataWire #0, Channel #10
70 m33syscpuss_interrupts_ipc_dpslp_0 (CPUSS) — m33syscpuss Inter Process Communication Interrupt #0
71 m33syscpuss_interrupts_dw0_11 (CPUSS) — cpuss[0] DataWire #0, Channel #11
71 m33syscpuss_interrupts_ipc_dpslp_1 (CPUSS) — m33syscpuss Inter Process Communication Interrupt #1
72 m33syscpuss_interrupts_dw0_12 (CPUSS) — cpuss[0] DataWire #0, Channel #12
72 m33syscpuss_interrupts_ipc_dpslp_2 (CPUSS) — m33syscpuss Inter Process Communication Interrupt #2
73 m33syscpuss_interrupts_dw0_13 (CPUSS) — cpuss[0] DataWire #0, Channel #13
73 m33syscpuss_interrupts_ipc_dpslp_3 (CPUSS) — m33syscpuss Inter Process Communication Interrupt #3
74 m33syscpuss_interrupts_dw0_14 (CPUSS) — cpuss[0] DataWire #0, Channel #14
74 m33syscpuss_interrupts_ipc_dpslp_4 (CPUSS) — m33syscpuss Inter Process Communication Interrupt #4
75 m33syscpuss_interrupts_dw0_15 (CPUSS) — cpuss[0] DataWire #0, Channel #15
75 m33syscpuss_interrupts_ipc_dpslp_5 (CPUSS) — m33syscpuss Inter Process Communication Interrupt #5
76 m33syscpuss_interrupts_ipc_dpslp_6 (CPUSS) — m33syscpuss Inter Process Communication Interrupt #6
76 m55appcpuss_interrupts_axidmac_0 (CPUSS)
77 m33syscpuss_interrupts_ipc_dpslp_7 (CPUSS) — m33syscpuss Inter Process Communication Interrupt #7
77 m55appcpuss_interrupts_axidmac_1 (CPUSS)
78 m55appcpuss_interrupts_axidmac_2 (CPUSS)
78 mxnnlite_interrupt_mxnnlite (CPUSS) — Interrupt of MXNNLITE
79 m33syscpuss_interrupts_cm33_0_cti_0 (CPUSS)
79 m55appcpuss_interrupts_axidmac_3 (CPUSS)
80 m33syscpuss_interrupts_cm33_0_cti_1 (CPUSS)
80 smif_0_smif0_interrupt (CPUSS) — SMIF Port0 interrupt
81 m33syscpuss_interrupt_cm33_0_fp (CPUSS) — CM33 0 Floating Point Interrupt
81 smif_0_smif1_interrupt (CPUSS) — SMIF Port0 interrupt
82 canfd_0_interrupts0_0 (CPUSS) — CAN #0, Interrupt0, Channel#0
82 m33syscpuss_interrupts_dw0_0 (CPUSS) — cpuss[0] DataWire #0, Channel #0
83 canfd_0_interrupts1_0 (CPUSS) — CAN #0, Interrupt1, Channel#0
83 m33syscpuss_interrupts_dw0_1 (CPUSS) — cpuss[0] DataWire #0, Channel #1
84 canfd_0_interrupts0_1 (CPUSS) — CAN #0, Interrupt0, Channel#1
84 m33syscpuss_interrupts_dw0_2 (CPUSS) — cpuss[0] DataWire #0, Channel #2
85 canfd_0_interrupts1_1 (CPUSS) — CAN #0, Interrupt1, Channel#1
85 m33syscpuss_interrupts_dw0_3 (CPUSS) — cpuss[0] DataWire #0, Channel #3
86 m33syscpuss_interrupts_dw0_4 (CPUSS) — cpuss[0] DataWire #0, Channel #4
86 tcpwm_0_interrupts_0 (CPUSS) — TCPWM, 32-bit Counter #0
87 m33syscpuss_interrupts_dw0_5 (CPUSS) — cpuss[0] DataWire #0, Channel #5
87 tcpwm_0_interrupts_1 (CPUSS) — TCPWM, 32-bit Counter #1
88 m33syscpuss_interrupts_dw0_6 (CPUSS) — cpuss[0] DataWire #0, Channel #6
88 tcpwm_0_interrupts_2 (CPUSS) — TCPWM, 32-bit Counter #2
89 m33syscpuss_interrupts_dw0_7 (CPUSS) — cpuss[0] DataWire #0, Channel #7
89 tcpwm_0_interrupts_3 (CPUSS) — TCPWM, 32-bit Counter #3
90 m33syscpuss_interrupts_dw0_8 (CPUSS) — cpuss[0] DataWire #0, Channel #8
90 tcpwm_0_interrupts_4 (CPUSS) — TCPWM, 32-bit Counter #4
91 m33syscpuss_interrupts_dw0_9 (CPUSS) — cpuss[0] DataWire #0, Channel #9
91 tcpwm_0_interrupts_5 (CPUSS) — TCPWM, 32-bit Counter #5
92 m33syscpuss_interrupts_dw0_10 (CPUSS) — cpuss[0] DataWire #0, Channel #10
92 tcpwm_0_interrupts_6 (CPUSS) — TCPWM, 32-bit Counter #6
93 m33syscpuss_interrupts_dw0_11 (CPUSS) — cpuss[0] DataWire #0, Channel #11
93 tcpwm_0_interrupts_7 (CPUSS) — TCPWM, 32-bit Counter #7
94 m33syscpuss_interrupts_dw0_12 (CPUSS) — cpuss[0] DataWire #0, Channel #12
94 tcpwm_0_interrupts_256 (CPUSS) — TCPWM, 16-bit Counter #0
95 m33syscpuss_interrupts_dw0_13 (CPUSS) — cpuss[0] DataWire #0, Channel #13
95 tcpwm_0_interrupts_257 (CPUSS) — TCPWM, 16-bit Counter #1
96 m33syscpuss_interrupts_dw0_14 (CPUSS) — cpuss[0] DataWire #0, Channel #14
96 tcpwm_0_interrupts_258 (CPUSS) — TCPWM, 16-bit Counter #2
97 m33syscpuss_interrupts_dw0_15 (CPUSS) — cpuss[0] DataWire #0, Channel #15
97 tcpwm_0_interrupts_259 (CPUSS) — TCPWM, 16-bit Counter #3
98 m55appcpuss_interrupts_axidmac_0 (CPUSS)
98 tcpwm_0_interrupts_260 (CPUSS) — TCPWM, 16-bit Counter #4
99 m55appcpuss_interrupts_axidmac_1 (CPUSS)
99 tcpwm_0_interrupts_261 (CPUSS) — TCPWM, 16-bit Counter #5
100 m55appcpuss_interrupts_axidmac_2 (CPUSS)
100 tcpwm_0_interrupts_262 (CPUSS) — TCPWM, 16-bit Counter #6
101 m55appcpuss_interrupts_axidmac_3 (CPUSS)
101 tcpwm_0_interrupts_263 (CPUSS) — TCPWM, 16-bit Counter #7
102 smif_0_smif0_interrupt (CPUSS) — SMIF Port0 interrupt
102 tcpwm_0_interrupts_264 (CPUSS) — TCPWM, 16-bit Counter #8
103 smif_0_smif1_interrupt (CPUSS) — SMIF Port1 interrupt
103 tcpwm_0_interrupts_265 (CPUSS) — TCPWM, 16-bit Counter #9
104 canfd_0_interrupts0_0 (CPUSS) — CAN #0, Interrupt0, Channel#0
104 tcpwm_0_interrupts_266 (CPUSS) — TCPWM, 16-bit Counter #10
105 canfd_0_interrupts1_0 (CPUSS) — CAN #0, Interrupt1, Channel#0
105 tcpwm_0_interrupts_267 (CPUSS) — TCPWM, 16-bit Counter #11
106 canfd_0_interrupts0_1 (CPUSS) — CAN #0, Interrupt0, Channel#1
106 tcpwm_0_interrupts_268 (CPUSS) — TCPWM, 16-bit Counter #12
107 canfd_0_interrupts1_1 (CPUSS) — CAN #0, Interrupt1, Channel#1
107 tcpwm_0_interrupts_269 (CPUSS) — TCPWM, 16-bit Counter #13
108 tcpwm_0_interrupts_0 (CPUSS) — TCPWM, 32-bit Counter #0
108 tcpwm_0_interrupts_270 (CPUSS) — TCPWM, 16-bit Counter #14
109 tcpwm_0_interrupts_1 (CPUSS) — TCPWM, 32-bit Counter #1
109 tcpwm_0_interrupts_271 (CPUSS) — TCPWM, 16-bit Counter #15
110 tcpwm_0_interrupts_2 (CPUSS) — TCPWM, 32-bit Counter #2
110 tcpwm_0_interrupts_272 (CPUSS) — TCPWM, 16-bit Counter #16
111 tcpwm_0_interrupts_273 (CPUSS) — TCPWM, 16-bit Counter #17
111 tcpwm_0_interrupts_3 (CPUSS) — TCPWM, 32-bit Counter #3
112 tcpwm_0_interrupts_274 (CPUSS) — TCPWM, 16-bit Counter #18
112 tcpwm_0_interrupts_4 (CPUSS) — TCPWM, 32-bit Counter #4
113 tcpwm_0_interrupts_275 (CPUSS) — TCPWM, 16-bit Counter #19
113 tcpwm_0_interrupts_5 (CPUSS) — TCPWM, 32-bit Counter #5
114 tcpwm_0_interrupts_276 (CPUSS) — TCPWM, 16-bit Counter #20
114 tcpwm_0_interrupts_6 (CPUSS) — TCPWM, 32-bit Counter #6
115 tcpwm_0_interrupts_277 (CPUSS) — TCPWM, 16-bit Counter #21
115 tcpwm_0_interrupts_7 (CPUSS) — TCPWM, 32-bit Counter #7
116 tcpwm_0_interrupts_256 (CPUSS) — TCPWM, 16-bit Counter #0
116 tcpwm_0_interrupts_278 (CPUSS) — TCPWM, 16-bit Counter #22
117 tcpwm_0_interrupts_257 (CPUSS) — TCPWM, 16-bit Counter #1
117 tcpwm_0_interrupts_279 (CPUSS) — TCPWM, 16-bit Counter #23
118 scb_1_interrupt (CPUSS)
118 tcpwm_0_interrupts_258 (CPUSS) — TCPWM, 16-bit Counter #2
119 scb_2_interrupt (CPUSS)
119 tcpwm_0_interrupts_259 (CPUSS) — TCPWM, 16-bit Counter #3
120 scb_3_interrupt (CPUSS)
120 tcpwm_0_interrupts_260 (CPUSS) — TCPWM, 16-bit Counter #4
121 scb_4_interrupt (CPUSS)
121 tcpwm_0_interrupts_261 (CPUSS) — TCPWM, 16-bit Counter #5
122 scb_5_interrupt (CPUSS)
122 tcpwm_0_interrupts_262 (CPUSS) — TCPWM, 16-bit Counter #6
123 scb_6_interrupt (CPUSS)
123 tcpwm_0_interrupts_263 (CPUSS) — TCPWM, 16-bit Counter #7
124 scb_7_interrupt (CPUSS)
124 tcpwm_0_interrupts_264 (CPUSS) — TCPWM, 16-bit Counter #8
125 scb_8_interrupt (CPUSS)
125 tcpwm_0_interrupts_265 (CPUSS) — TCPWM, 16-bit Counter #9
126 scb_9_interrupt (CPUSS)
126 tcpwm_0_interrupts_266 (CPUSS) — TCPWM, 16-bit Counter #10
127 scb_10_interrupt (CPUSS)
127 tcpwm_0_interrupts_267 (CPUSS) — TCPWM, 16-bit Counter #11
128 scb_11_interrupt (CPUSS)
128 tcpwm_0_interrupts_268 (CPUSS) — TCPWM, 16-bit Counter #12
129 sdhc_0_interrupt_general (CPUSS) — SDHC0
129 tcpwm_0_interrupts_269 (CPUSS) — TCPWM, 16-bit Counter #13
130 sdhc_0_interrupt_wakeup (CPUSS) — SDHC0
130 tcpwm_0_interrupts_270 (CPUSS) — TCPWM, 16-bit Counter #14
131 sdhc_1_interrupt_general (CPUSS) — SDHC1
131 tcpwm_0_interrupts_271 (CPUSS) — TCPWM, 16-bit Counter #15
132 sdhc_1_interrupt_wakeup (CPUSS) — SDHC1
132 tcpwm_0_interrupts_272 (CPUSS) — TCPWM, 16-bit Counter #16
133 tcpwm_0_interrupts_273 (CPUSS) — TCPWM, 16-bit Counter #17
133 tdm_0_interrupts_rx_0 (CPUSS) — TDM0 Audio interrupt RX Structure#0
134 tcpwm_0_interrupts_274 (CPUSS) — TCPWM, 16-bit Counter #18
134 tdm_0_interrupts_tx_0 (CPUSS) — TDM0 Audio interrupt TX Structure#0
135 tcpwm_0_interrupts_275 (CPUSS) — TCPWM, 16-bit Counter #19
135 tdm_0_interrupts_rx_1 (CPUSS) — TDM0 Audio interrupt RX Structure#1
136 tcpwm_0_interrupts_276 (CPUSS) — TCPWM, 16-bit Counter #20
136 tdm_0_interrupts_tx_1 (CPUSS) — TDM0 Audio interrupt TX Structure#1
137 gfxss_interrupt_gpu (CPUSS) — Interrupt from GPU.
137 tcpwm_0_interrupts_277 (CPUSS) — TCPWM, 16-bit Counter #21
138 gfxss_interrupt_dc (CPUSS) — Interrupt from DC.
138 tcpwm_0_interrupts_278 (CPUSS) — TCPWM, 16-bit Counter #22
139 gfxss_interrupt_mipidsi (CPUSS) — Interrupt from MIPIDSI.
139 tcpwm_0_interrupts_279 (CPUSS) — TCPWM, 16-bit Counter #23
140 pdm_0_interrupts_0 (CPUSS) — PDM interrupt Structure#0
140 scb_1_interrupt (CPUSS)
141 pdm_0_interrupts_1 (CPUSS) — PDM interrupt Structure#1
141 scb_2_interrupt (CPUSS)
142 pdm_0_interrupts_2 (CPUSS) — PDM interrupt Structure#2
142 scb_3_interrupt (CPUSS)
143 pdm_0_interrupts_3 (CPUSS) — PDM interrupt Structure#3
143 scb_4_interrupt (CPUSS)
144 pdm_0_interrupts_4 (CPUSS) — PDM interrupt Structure#4
144 scb_5_interrupt (CPUSS)
145 pdm_0_interrupts_5 (CPUSS) — PDM interrupt Structure#5
145 scb_6_interrupt (CPUSS)
146 eth_interrupt_eth_0 (CPUSS) — ETH Interrupt#0
146 scb_7_interrupt (CPUSS)
147 eth_interrupt_eth_1 (CPUSS) — ETH Interrupt#1
147 scb_8_interrupt (CPUSS)
148 eth_interrupt_eth_2 (CPUSS) — ETH Interrupt#2
148 scb_9_interrupt (CPUSS)
149 scb_10_interrupt (CPUSS)
149 usbhs_interrupt_usbhsctrl (CPUSS) — Interrupt of Controller core
150 scb_11_interrupt (CPUSS)
150 usbhs_interrupt_usbhsss (CPUSS) — Interrupt of Subsystem
151 i3c_interrupt (CPUSS)
151 mxu55_interrupt_npu (CPUSS) — Interrupt requests of armu55 (NPU)
152 crypto_interrupt (CPUSS)
152 sdhc_0_interrupt_general (CPUSS) — SDHC0
153 m33syscpuss_interrupts_fault_0 (CPUSS)
153 sdhc_0_interrupt_wakeup (CPUSS) — SDHC0
154 m33syscpuss_interrupts_fault_1 (CPUSS)
154 sdhc_1_interrupt_general (CPUSS) — SDHC1
155 m55appcpuss_interrupt_ahb2axi_buff_err (CPUSS) — Interrupt from xhb500 ahb to axi bridge
155 sdhc_1_interrupt_wakeup (CPUSS) — SDHC1
156 tdm_0_interrupts_rx_0 (CPUSS) — TDM0 Audio interrupt RX Structure#0
157 tdm_0_interrupts_tx_0 (CPUSS) — TDM0 Audio interrupt TX Structure#0
158 tdm_0_interrupts_rx_1 (CPUSS) — TDM0 Audio interrupt RX Structure#1
159 tdm_0_interrupts_tx_1 (CPUSS) — TDM0 Audio interrupt TX Structure#1
160 gfxss_interrupt_gpu (CPUSS) — Interrupt from GPU.
161 gfxss_interrupt_dc (CPUSS) — Interrupt from DC.
162 gfxss_interrupt_mipidsi (CPUSS) — Interrupt from MIPIDSI.
163 pdm_0_interrupts_0 (CPUSS) — PDM interrupt Structure#0
164 pdm_0_interrupts_1 (CPUSS) — PDM interrupt Structure#1
165 pdm_0_interrupts_2 (CPUSS) — PDM interrupt Structure#2
166 pdm_0_interrupts_3 (CPUSS) — PDM interrupt Structure#3
167 pdm_0_interrupts_4 (CPUSS) — PDM interrupt Structure#4
168 pdm_0_interrupts_5 (CPUSS) — PDM interrupt Structure#5
169 eth_interrupt_eth_0 (CPUSS) — ETH Interrupt#0
170 eth_interrupt_eth_1 (CPUSS) — ETH Interrupt#1
171 eth_interrupt_eth_2 (CPUSS) — ETH Interrupt#2
172 usbhs_interrupt_usbhsctrl (CPUSS) — Interrupt of Controller core
173 usbhs_interrupt_usbhsss (CPUSS) — Interrupt of Subsystem
174 i3c_interrupt (CPUSS)
175 m33syscpuss_interrupt_msc (CPUSS)
176 crypto_interrupt (CPUSS)
177 m33syscpuss_interrupts_fault_0 (CPUSS)
178 m33syscpuss_interrupts_fault_1 (CPUSS)

## Licence text in the file
(c) 2016-2021, Cypress Semiconductor Corporation (an Infineon company) or an affiliate of Cypress Semiconductor Corporation. . SPDX-License-Identifier: Apache-2.0 . Licensed under the Apache License, Version 2.0 (the "License"); you may not use this file except in compliance with the License. You may obtain a copy of the License at http://www.apache.org/licenses/LICENSE-2.0 . Unless required by applicable law or agreed to in writing, software distributed under the License is distributed on an "AS IS" BASIS, WITHOUT WARRANTIES OR CONDITIONS OF ANY KIND, either express or implied. See the License for the specific language governing permissions and limitations under the License.
